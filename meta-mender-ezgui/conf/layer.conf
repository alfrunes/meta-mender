## meta-mender-ezgui/conf/layer.conf
```bitbake
# We have a conf and classes directory, add to BBPATH
BBPATH .= ":${LAYERDIR}"

# We have recipes-* directories, add to BBFILES
BBFILES += "${LAYERDIR}/recipes-*/*/*.bb \
	${LAYERDIR}/recipes-*/*/*.bbappend"

BBFILE_COLLECTIONS += "mender-ezgui"
BBFILE_PATTERN_mender-ezgui = "^${LAYERDIR}/"
BBFILE_PRIORITY_mender-ezgui = "6"
```
